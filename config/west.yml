## config/west.yml
```yaml
manifest:
  remotes:
    - name: zmkfirmware
      url-base: https://github.com/petejohanson
    - name: HNH-NASA
      url-base: https://github.com/HNH-NASA
    - name: caksoylar  # <-- led
      url-base: https://github.com/caksoylar  
  projects:
    - name: zmk
      remote: zmkfirmware
      revision: feat/pointers-move-scroll
      import: app/west.yml
    - name: zmk-pmw3610-driver  # <-- トラボドライバ
      remote: HNH-NASA
      revision: main
     - name: zmk-rgbled-widget  # <-- led
      remote: caksoylar
      revision: main
 self:
    path: config
```
